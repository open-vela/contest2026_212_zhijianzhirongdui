/****************************************************************************
 * drivers/video/ov3660.c
 * OV3660 camera sensor driver for NuttX/openvela
 * Register tables adapted from ESP-IDF esp32-camera (MIT license)
 ****************************************************************************/
#include <nuttx/config.h>
#include <sys/types.h>
#include <string.h>
#include <errno.h>
#include <debug.h>
#include <nuttx/arch.h>
#include <nuttx/i2c/i2c_master.h>
#include <nuttx/video/ov3660.h>

/* I2C address: OV3660 uses 0x3C (7-bit) */
#define OV3660_I2C_ADDR  0x3C

/* Register access helpers */
#define REG_DLY   0xFFFF
#define REGLIST_TAIL 0x0000

/* OV3660 chip ID */
#define OV3660_PID       0x3660
#define OV3660_PID_REG_H 0x300A
#define OV3660_PID_REG_L 0x300B

struct ov3660_reg_s {
  uint16_t reg;
  uint8_t  val;
};

/****************************************************************************
 * Register Initialization Table
 * Source: ESP-IDF esp32-camera/sensors/private_include/ov3660_settings.h
 ****************************************************************************/
static const struct ov3660_reg_s g_ov3660_init_regs[] = {
  /* v4.0: byte-exact Arduino working config dump */
  {0x3000, 0x10},
  {0x3001, 0x08},
  {0x3002, 0x00},
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  {0x5607, 0x00},
  {REGLIST_TAIL, 0x00},
};


/****************************************************************************
 * Private Functions
 ****************************************************************************/

static int ov3660_write_reg(FAR struct i2c_master_s *i2c,
                            uint16_t reg, uint8_t val)
{
  struct i2c_msg_s msg;
  uint8_t buf[3];
  int ret;

  buf[0] = (reg >> 8) & 0xFF;
  buf[1] = reg & 0xFF;
  buf[2] = val;

  msg.frequency = 100000;
  msg.addr      = OV3660_I2C_ADDR;
  msg.flags     = 0;
  msg.buffer    = buf;
  msg.length    = 3;

  ret = I2C_TRANSFER(i2c, &msg, 1);
  if (ret < 0)
    {
      gerr("ERROR: ov3660_write_reg(0x%04X) failed: %d\n", reg, ret);
    }
  return ret;
}

static int ov3660_read_reg(FAR struct i2c_master_s *i2c,
                           uint16_t reg, FAR uint8_t *val)
{
  struct i2c_msg_s msg[2];
  uint8_t regbuf[2];
  int ret;

  regbuf[0] = (reg >> 8) & 0xFF;
  regbuf[1] = reg & 0xFF;

  msg[0].frequency = 100000;
  msg[0].addr      = OV3660_I2C_ADDR;
  msg[0].flags     = 0;
  msg[0].buffer    = regbuf;
  msg[0].length    = 2;

  msg[1].frequency = 100000;
  msg[1].addr      = OV3660_I2C_ADDR;
  msg[1].flags     = I2C_M_READ;
  msg[1].buffer    = val;
  msg[1].length    = 1;

  ret = I2C_TRANSFER(i2c, msg, 2);
  if (ret < 0)
    {
      gerr("ERROR: ov3660_read_reg(0x%04X) failed: %d\n", reg, ret);
    }
  return ret;
}

static int ov3660_write_regs(FAR struct i2c_master_s *i2c,
                             FAR const struct ov3660_reg_s *regs)
{
  int ret = OK;
  unsigned int i;

  for (i = 0; regs[i].reg != REGLIST_TAIL; i++)
    {
      if (regs[i].reg == REG_DLY)
        {
          up_mdelay(regs[i].val);
        }
      else
        {
          ret = ov3660_write_reg(i2c, regs[i].reg, regs[i].val);
          if (ret < 0)
            {
              return ret;
            }
        }
    }
  return OK;
}

/****************************************************************************
 * Public Functions
 ****************************************************************************/

int ov3660_initialize(FAR struct i2c_master_s *i2c)
{
  uint8_t pid_h, pid_l;
  uint16_t pid;
  int ret;

  ginfo("OV3660: Probing at I2C addr 0x%02X...\n", OV3660_I2C_ADDR);

  /* Software reset: write 0x82 to 0x3103 */
  ret = ov3660_write_reg(i2c, 0x3103, 0x82);
  if (ret < 0)
    {
      gerr("ERROR: OV3660 reset failed: %d\n", ret);
      return ret;
    }
  up_mdelay(10);

  /* Read product ID */
  ret = ov3660_read_reg(i2c, OV3660_PID_REG_H, &pid_h);
  if (ret < 0)
    {
      gerr("ERROR: OV3660 PID high read failed: %d\n", ret);
      return -ENODEV;
    }

  ret = ov3660_read_reg(i2c, OV3660_PID_REG_L, &pid_l);
  if (ret < 0)
    {
      gerr("ERROR: OV3660 PID low read failed: %d\n", ret);
      return -ENODEV;
    }

  pid = ((uint16_t)pid_h << 8) | pid_l;
  ginfo("OV3660: PID = 0x%04X\n", pid);

  if (pid != OV3660_PID)
    {
      gerr("ERROR: OV3660: Unexpected PID 0x%04X (expected 0x%04X)\n",
           pid, OV3660_PID);
      return -ENODEV;
    }

  /* Load initialization registers */
  ret = ov3660_write_regs(i2c, g_ov3660_init_regs);
  if (ret < 0)
    {
      gerr("ERROR: OV3660 init regs failed: %d\n", ret);
      return ret;
    }

  ginfo("OV3660: Initialized successfully\n");
  return OK;
}

int ov3660_start_streaming(FAR struct i2c_master_s *i2c)
{
  int ret;

  /* Exit software standby (init table sets 0x3008=0x02, bit1=standby).
   * Clear bit 1 to start DVP output. */
  ret = ov3660_write_reg(i2c, 0x3008, 0x00);
  if (ret < 0)
    {
      gerr("ERROR: Failed to exit standby (0x3008): %d\n", ret);
      return ret;
    }
  up_mdelay(5);

  /* Enable VSYNC, PCLK, HREF output pads (pad drivers = 0x1A) */

  ret = ov3660_write_reg(i2c, 0x3031, 0x1A);
  if (ret < 0)
    {
      gerr("ERROR: Failed to write 0x3031: %d\n", ret);
      return ret;
    }

  /* Enable D[7:0] data output */

  ret = ov3660_write_reg(i2c, 0x3017, 0xFF);
  if (ret < 0)
    {
      gerr("ERROR: Failed to write 0x3017: %d\n", ret);
      return ret;
    }

  /* Enable D[9:8] data output */

  ret = ov3660_write_reg(i2c, 0x3018, 0xFF);
  if (ret < 0)
    {
      gerr("ERROR: Failed to write 0x3018: %d\n", ret);
      return ret;
    }

  /* Set output format: YUV422, YUYV */

  ret = ov3660_write_reg(i2c, 0x4300, 0xE1);
  if (ret < 0)
    {
      return ret;
    }

  ret = ov3660_write_reg(i2c, 0x4301, 0x01);
  if (ret < 0)
    {
      return ret;
    }

  /* ISP input source: YUV from digital interface */

  ret = ov3660_write_reg(i2c, 0x501F, 0x03);
  if (ret < 0)
    {
      return ret;
    }

  ginfo("OV3660: Streaming started (pads enabled)\n");
  return OK;
}
